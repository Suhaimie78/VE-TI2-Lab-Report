VERSION ""

NS_ :

BS_:

BU_: Drehratensensor

BO_ 512 Drehbeschleunigung: 6 Drehratensensor
 SG_ Querbeschleunigung_in_X_Richtung : 32|32@1+ (0.000127465,-4.1768) [-4.1768|547453.829457175] "*/s" Vector__XXX
 SG_ Drehbeschleunigung : 0|8@1+ (0.125,-4095) [-4095|4095] "*/s" Vector__XXX

BO_ 256 Drehgeschwindigkeit: 6 Drehratensensor
 SG_ Querbeschleunigung_in_Y_Richtung : 16|32@1+ (0.000127465,-4.1768) [-4.1768|4.1768] "*/s" Vector__XXX
 SG_ Drehgeschwindigkeit : 0|8@1+ (0.005,-163.84) [-163.84|163.84] "*/s" Vector__XXX
